; zero page

COLORONOFF      := $00          ; color on/off
COLORFG         := $01          ; color foreground
COLORBG         := $02          ; color background
CURSESCOLORS    := $03          ; curses colors (16 Bytes)
TMP1            := $13          ; temp. var
TMP2            := $14          ; temp. var
TMP3            := $15          ; temp. var
TMP4            := $16          ; temp. var
TMP5            := $17          ; temp. var
TMP6            := $18          ; temp. var
TMP7            := $19          ; temp. var
TMP8            := $1A          ; temp. var
TMP9            := $1B          ; temp. var
TMP10           := $1C          ; temp. var
TMP11           := $1D          ; temp. var
TMP12           := $1E          ; temp. var
TMP13           := $1F          ; temp. var
TMP14           := $20          ; temp. var
TMP15           := $21          ; temp. var
TMP16           := $22          ; temp. var
TMP17           := $23          ; temp. var
TMP18           := $24          ; temp. var
TMP19           := $25          ; temp. var
TMP20           := $26          ; temp. var
TMP21           := $27          ; temp. var
TMP22           := $28          ; temp. var
TMP23           := $29          ; temp. var
TMP24           := $2A          ; temp. var
TMP25           := $2B          ; temp. var
TMP26           := $2C          ; temp. var
TMP27           := $2D          ; temp. var
TMP28           := $2E          ; temp. var
TMP29           := $2F          ; temp. var
TMP30           := $30          ; temp. var
TMP31           := $31          ; temp. var
TMP32           := $32          ; temp. var
TMP33           := $33          ; temp. var
TMP34           := $34          ; temp. var
TMP35           := $35          ; temp. var
TMP36           := $36          ; temp. var
TMP37           := $37          ; temp. var
TMP38           := $38          ; temp. var
TMP39           := $39          ; temp. var
TMP40           := $3A          ; temp. var
TMP41           := $3B          ; temp. var
TMP42           := $3C          ; temp. var
ECHOONOFF       := $3D          ; echo on/off
NONBLOCKONOFF   := $3E          ; getch non-blocking/blocking call

; screen size

SCRXSIZE        = 40
SCRYSIZE        = 25

; standard color

STDCOLOR        = 240
