.ORG	KEYBMAP
; 0 - 7
.db 0, 0, 0, KEYF5, KEYF3, KEYF1, KEYF2, 0
; 8 - 15
.db 0, 0, KEYF8, KEYF6, KEYF4, KEYTAB, 0, 0
; 16 - 23
.db 0, 0, 0, 0, 0, 'q', '1', 0
; 24 - 31
.db 0, 0, 'y', 's', 'a', 'w', '2', 0
; 32 - 39
.db 0, 'c', 'x', 'd', 'e', '4', '3', 0
; 40 - 47
.db 0, ' ', 'v', 'f', 't', 'r', '5', 0
; 48 - 55
.db 0, 'n', 'b', 'h', 'g', 'z', '6', 0
; 56 - 63
.db 0, 0, 'm', 'j', 'u', '7', '8', 0
; 64 - 71
.db 0, ',', 'k', 'i', 'o', '0', '9', 0
; 72 - 79
.db 0, '.', '-', 'l', '{', 'p', 39, 0
; 80 - 87
.db 0, 0, '}', 0, '[', '^', 0, 0
; 88 - 95
.db 0, 0, 10, ']', 0, '$', 0, 0
; 96 - 103
.db 0, '<', 0, 0, 0, 0, KEYBACKSPACE, 0
; 104 - 111
.db 0, '1', 0, '4', '7', 0, 0, 0
; 112 - 119
.db '0', '.', '2', '5', '6', '8', KEYESCAPE, KEYNUMLCK
; 120 - 127
.db 0, '+', '3', '-', '*', '9', KEYSCRLCK, 0
; 128 - 135
.db 0, 0, 0, KEYF7, 0, 0, 0, 0
; 136 - 143
.db 0, 0, 0, 0, 0, 0, 0, 0
; 144 - 151
.db 0, 0, 0, 0, 0, 'Q', '+', 0
; 152 - 159
.db 0, 0, 'Y', 'S', 'A', 'W', 34, KEYWINLEFT
; 160 - 167
.db 0, 'C', 'X', 'D', 'E', 0, '*', KEYWINRIGHT
; 168 - 175
.db 0, ' ', 'V', 'F', 'T', 'R', '%', 0
; 176 - 183
.db 0, 'N', 'B', 'H', 'G', 'Z', '&', 0
; 184 - 191
.db 0, 0, 'M', 'J', 'U', '/', '(', 0
; 192 - 199
.db 0, ';', 'K', 'I', 'O', '=', ')', 0
; 200 - 207
.db 0, ':', '_', 'L', '\', 'P', '?', 0
; 208 - 215
.db 0, 0, '`', 0, '|', '~', 0, 0
; 216 - 223
.db 0, 0, 10, '!', 0, 127, 0, 0
; 224 - 231
.db 0, '>', 0, 0, 0, 0, KEYBACKSPACE, 0
; 232 - 239
.db 0, KEYEND, 0, KEYCURLEFT, KEYHOME, 0, 0, 0
; 240 - 247
.db KEYINSERT, KEYDELETE, KEYCURDOWN, '5', KEYCURRIGHT, KEYCURUP, KEYESCAPE, 0
; 248 - 255
.db 0, '+', KEYPGDOWN, '-', KEYPRTSCR, KEYPGUP, 0, 0
