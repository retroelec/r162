.byt 60,0,0,0,0,0,0,0
.byt 0,0,0,0,0,0,0,0
.byt 0,0,0,0,0,0,0,0
.byt 0,0,0,60,12,60,0,0
.byt 0,24,102,102,24,98,60,6
.byt 12,48,0,0,0,0,0,0
.byt 60,24,60,60,6,126,60,126
.byt 60,60,0,0,14,0,112,60
.byt 0,24,124,60,120,126,126,60
.byt 102,60,30,102,96,99,102,60
.byt 124,60,124,60,126,102,102,99
.byt 102,102,126,24,192,24,51,51
.byt 0,240,0,255,0,192,204,3
.byt 0,204,3,24,0,24,0,0
.byt 0,24,0,24,192,224,7,255
.byt 255,0,1,0,15,24,240,240
.byt 195,255,255,255,255,255,255,255
.byt 255,255,255,255,255,255,255,255
.byt 255,255,255,255,255,255,255,255
.byt 255,255,255,195,243,195,255,255
.byt 255,231,153,153,231,157,195,249
.byt 243,207,255,255,255,255,255,255
.byt 195,231,195,195,249,129,195,129
.byt 195,195,255,255,241,255,143,195
.byt 255,231,131,195,135,129,129,195
.byt 153,195,225,153,159,156,153,195
.byt 131,195,131,195,129,153,153,156
.byt 153,153,129,231,63,231,204,204
.byt 255,15,255,0,255,63,51,252
.byt 255,51,252,231,255,231,255,255
.byt 255,231,255,231,63,31,248,0
.byt 0,255,254,255,240,231,15,15
.byt 102,0,96,0,6,0,14,0
.byt 96,24,6,96,56,0,0,0
.byt 0,0,0,0,24,0,0,0
.byt 0,0,0,48,18,12,24,16
.byt 0,24,102,102,62,102,102,12
.byt 24,24,102,24,0,0,0,3
.byt 102,24,102,102,14,96,102,102
.byt 102,102,0,0,24,0,24,102
.byt 0,60,102,102,108,96,96,102
.byt 102,24,12,108,96,119,118,102
.byt 102,102,102,102,24,102,102,99
.byt 102,102,6,24,192,24,51,153
.byt 0,240,0,0,0,192,204,3
.byt 0,153,3,24,0,24,0,0
.byt 0,24,0,24,192,224,7,255
.byt 255,0,3,0,15,24,240,240
.byt 153,255,159,255,249,255,241,255
.byt 159,231,249,159,199,255,255,255
.byt 255,255,255,255,231,255,255,255
.byt 255,255,255,207,237,243,231,239
.byt 255,231,153,153,193,153,153,243
.byt 231,231,153,231,255,255,255,252
.byt 153,231,153,153,241,159,153,153
.byt 153,153,255,255,231,255,231,153
.byt 255,195,153,153,147,159,159,153
.byt 153,231,243,147,159,136,137,153
.byt 153,153,153,153,231,153,153,156
.byt 153,153,249,231,63,231,204,102
.byt 255,15,255,255,255,63,51,252
.byt 255,102,252,231,255,231,255,255
.byt 255,231,255,231,63,31,248,0
.byt 0,255,252,255,240,231,15,15
.byt 110,60,96,60,6,60,24,62
.byt 96,0,0,96,24,102,124,60
.byt 124,62,124,62,126,102,102,99
.byt 102,102,126,48,48,12,60,48
.byt 0,24,102,255,96,12,60,24
.byt 48,12,60,24,0,0,0,6
.byt 110,56,6,6,30,124,96,12
.byt 102,102,24,24,48,126,12,6
.byt 0,102,102,96,102,96,96,96
.byt 102,24,12,120,96,127,126,102
.byt 102,102,102,96,24,102,102,99
.byt 60,102,12,24,48,24,204,204
.byt 0,240,0,0,0,192,51,3
.byt 0,51,3,24,0,24,0,0
.byt 0,24,0,24,192,224,7,0
.byt 255,0,6,0,15,24,240,240
.byt 145,195,159,195,249,195,231,193
.byt 159,255,255,159,231,153,131,195
.byt 131,193,131,193,129,153,153,156
.byt 153,153,129,207,207,243,195,207
.byt 255,231,153,0,159,243,195,231
.byt 207,243,195,231,255,255,255,249
.byt 145,199,249,249,225,131,159,243
.byt 153,153,231,231,207,129,243,249
.byt 255,153,153,159,153,159,159,159
.byt 153,231,243,135,159,128,129,153
.byt 153,153,153,159,231,153,153,156
.byt 195,153,243,231,207,231,51,51
.byt 255,15,255,255,255,63,204,252
.byt 255,204,252,231,255,231,255,255
.byt 255,231,255,231,63,31,248,255
.byt 0,255,249,255,240,231,15,15
.byt 110,6,124,96,62,102,62,102
.byt 124,56,6,108,24,127,102,102
.byt 102,102,102,96,24,102,102,107
.byt 60,102,12,48,124,12,126,127
.byt 0,24,0,102,60,24,56,0
.byt 48,12,255,126,0,126,0,12
.byt 118,24,12,28,102,6,124,24
.byt 60,62,0,0,96,0,6,12
.byt 255,126,124,96,102,120,120,110
.byt 126,24,12,112,96,107,126,102
.byt 124,102,124,60,24,102,102,107
.byt 24,60,24,255,48,24,204,102
.byt 0,240,0,0,0,192,51,3
.byt 0,102,3,31,0,31,248,0
.byt 31,255,255,248,192,224,7,0
.byt 0,0,108,0,15,248,240,240
.byt 145,249,131,159,193,153,193,153
.byt 131,199,249,147,231,128,153,153
.byt 153,153,153,159,231,153,153,148
.byt 195,153,243,207,131,243,129,128
.byt 255,231,255,153,195,231,199,255
.byt 207,243,0,129,255,129,255,243
.byt 137,231,243,227,153,249,131,231
.byt 195,193,255,255,159,255,249,243
.byt 0,129,131,159,153,135,135,145
.byt 129,231,243,143,159,148,129,153
.byt 131,153,131,195,231,153,153,148
.byt 231,195,231,0,207,231,51,153
.byt 255,15,255,255,255,63,204,252
.byt 255,153,252,224,255,224,7,255
.byt 224,0,0,7,63,31,248,255
.byt 255,255,147,255,240,7,15,15
.byt 96,62,102,96,102,126,24,102
.byt 102,24,6,120,24,127,102,102
.byt 102,102,96,60,24,102,102,127
.byt 24,102,24,48,48,12,24,127
.byt 0,0,0,255,6,48,103,0
.byt 48,12,60,24,0,0,0,24
.byt 102,24,48,6,127,6,102,24
.byt 102,6,0,0,48,126,12,24
.byt 255,102,102,96,102,96,96,102
.byt 102,24,12,120,96,99,110,102
.byt 96,102,120,6,24,102,102,127
.byt 60,24,48,255,192,24,51,51
.byt 0,240,255,0,0,192,204,3
.byt 204,204,3,31,15,31,248,0
.byt 31,255,255,248,192,224,7,0
.byt 0,0,120,240,0,248,0,15
.byt 159,193,153,159,153,129,231,153
.byt 153,231,249,135,231,128,153,153
.byt 153,153,159,195,231,153,153,128
.byt 231,153,231,207,207,243,231,128
.byt 255,255,255,0,249,207,152,255
.byt 207,243,195,231,255,255,255,231
.byt 153,231,207,249,128,249,153,231
.byt 153,249,255,255,207,129,243,231
.byt 0,153,153,159,153,159,159,153
.byt 153,231,243,135,159,156,145,153
.byt 159,153,135,249,231,153,153,128
.byt 195,231,207,0,63,231,204,204
.byt 255,15,0,255,255,63,51,252
.byt 51,51,252,224,240,224,7,255
.byt 224,0,0,7,63,31,248,255
.byt 255,255,135,15,255,7,255,240
.byt 98,102,102,96,102,96,24,62
.byt 102,24,6,108,24,107,102,102
.byt 124,62,96,6,24,102,60,62
.byt 60,62,48,48,98,12,24,48
.byt 0,0,0,102,124,102,102,0
.byt 24,24,102,24,24,0,24,48
.byt 102,24,96,102,6,102,102,24
.byt 102,102,24,24,24,0,24,0
.byt 0,102,102,102,108,96,96,102
.byt 102,24,108,108,96,99,102,102
.byt 96,60,108,102,24,102,60,119
.byt 102,24,96,24,192,24,51,153
.byt 0,240,255,0,0,192,204,3
.byt 204,153,3,24,15,0,24,0
.byt 24,0,24,24,192,224,7,0
.byt 0,255,112,240,0,0,0,15
.byt 153,153,153,159,153,159,231,193
.byt 153,231,249,147,231,148,153,153
.byt 131,193,159,249,231,153,195,193
.byt 195,193,207,207,157,243,231,207
.byt 255,255,255,153,131,153,153,255
.byt 231,231,153,231,231,255,231,207
.byt 153,231,159,153,249,153,153,231
.byt 153,153,231,231,231,255,231,255
.byt 255,153,153,153,147,159,159,153
.byt 153,231,147,147,159,156,153,153
.byt 159,195,147,153,231,153,195,136
.byt 153,231,159,231,63,231,204,102
.byt 255,15,0,255,255,63,51,252
.byt 51,102,252,231,240,255,231,255
.byt 231,255,231,231,63,31,248,255
.byt 255,0,143,15,255,255,255,240
.byt 60,62,124,60,62,60,24,6
.byt 102,60,6,102,60,99,102,60
.byt 96,6,96,124,14,62,24,54
.byt 102,12,126,60,252,60,24,16
.byt 0,24,0,102,24,70,63,0
.byt 12,48,0,0,24,0,24,96
.byt 60,126,126,60,6,60,60,24
.byt 60,60,0,24,14,0,112,24
.byt 0,102,124,60,120,126,96,60
.byt 102,60,56,102,126,99,102,60
.byt 96,14,102,60,24,60,24,99
.byt 102,24,126,24,48,24,204,204
.byt 0,240,255,0,0,192,51,3
.byt 51,51,3,24,15,0,24,255
.byt 24,0,24,24,192,224,7,0
.byt 0,255,96,240,0,0,0,15
.byt 195,193,131,195,193,195,231,249
.byt 153,195,249,153,195,156,153,195
.byt 159,249,159,131,241,193,231,201
.byt 153,243,129,195,3,195,231,239
.byt 255,231,255,153,231,185,192,255
.byt 243,207,255,255,231,255,231,159
.byt 195,129,129,195,249,195,195,231
.byt 195,195,255,231,241,255,143,231
.byt 255,153,131,195,135,129,159,195
.byt 153,195,199,153,129,156,153,195
.byt 159,241,153,195,231,195,231,156
.byt 153,231,129,231,207,231,51,51
.byt 255,15,0,255,255,63,204,252
.byt 204,204,252,231,240,255,231,0
.byt 231,255,231,231,63,31,248,255
.byt 255,0,159,15,255,255,255,240
.byt 0,0,0,0,0,0,0,124
.byt 0,0,60,0,0,0,0,0
.byt 96,6,0,0,0,0,0,0
.byt 0,120,0,0,0,0,24,0
.byt 0,0,0,0,0,0,0,0
.byt 0,0,0,0,48,0,0,0
.byt 0,0,0,0,0,0,0,0
.byt 0,0,0,48,0,0,0,0
.byt 0,0,0,0,0,0,0,0
.byt 0,0,0,0,0,0,0,0
.byt 0,0,0,0,0,0,0,0
.byt 0,0,0,24,48,24,204,102
.byt 0,240,255,0,255,192,51,3
.byt 51,102,3,24,15,0,24,255
.byt 24,0,24,24,192,224,7,0
.byt 0,255,0,240,0,0,0,15
.byt 255,255,255,255,255,255,255,131
.byt 255,255,195,255,255,255,255,255
.byt 159,249,255,255,255,255,255,255
.byt 255,135,255,255,255,255,231,255
.byt 255,255,255,255,255,255,255,255
.byt 255,255,255,255,207,255,255,255
.byt 255,255,255,255,255,255,255,255
.byt 255,255,255,207,255,255,255,255
.byt 255,255,255,255,255,255,255,255
.byt 255,255,255,255,255,255,255,255
.byt 255,255,255,255,255,255,255,255
.byt 255,255,255,231,207,231,51,153
.byt 255,15,0,255,0,63,204,252
.byt 204,153,252,231,240,255,231,0
.byt 231,255,231,231,63,31,248,255
.byt 255,0,255,15,255,255,255,240
