; fC(1) = 32.703200
SNDN8C1H = 119
SNDN8C1L = 113
; fCIS(1) = 34.647900
SNDN8CIS1H = 112
SNDN8CIS1L = 189
; fD(1) = 36.708100
SNDN8D1H = 106
SNDN8D1L = 105
; fDIS(1) = 38.890900
SNDN8DIS1H = 100
SNDN8DIS1L = 112
; fE(1) = 41.203500
SNDN8E1H = 94
SNDN8E1L = 205
; fF(1) = 43.653600
SNDN8F1H = 89
SNDN8F1L = 123
; fFIS(1) = 46.249300
SNDN8FIS1H = 84
SNDN8FIS1L = 117
; fG(1) = 48.999500
SNDN8G1H = 79
SNDN8G1L = 183
; fGIS(1) = 51.913000
SNDN8GIS1H = 75
SNDN8GIS1L = 62
; fA(1) = 55.000000
SNDN8A1H = 71
SNDN8A1L = 5
; fAIS(1) = 58.270500
SNDN8AIS1H = 67
SNDN8AIS1L = 8
; fB(1) = 61.735400
SNDN8B1H = 63
SNDN8B1L = 69
; fC(2) = 65.406400
SNDN8C2H = 59
SNDN8C2L = 184
; fCIS(2) = 69.295800
SNDN8CIS2H = 56
SNDN8CIS2L = 94
; fD(2) = 73.416200
SNDN8D2H = 53
SNDN8D2L = 52
; fDIS(2) = 77.781800
SNDN8DIS2H = 50
SNDN8DIS2L = 55
; fE(2) = 82.407000
SNDN8E2H = 47
SNDN8E2L = 102
; fF(2) = 87.307200
SNDN8F2H = 44
SNDN8F2L = 189
; fFIS(2) = 92.498600
SNDN8FIS2H = 42
SNDN8FIS2L = 58
; fG(2) = 97.999000
SNDN8G2H = 39
SNDN8G2L = 219
; fGIS(2) = 103.826000
SNDN8GIS2H = 37
SNDN8GIS2L = 158
; fA(2) = 110.000000
SNDN8A2H = 35
SNDN8A2L = 130
; fAIS(2) = 116.541000
SNDN8AIS2H = 33
SNDN8AIS2L = 132
; fB(2) = 123.470800
SNDN8B2H = 31
SNDN8B2L = 162
; fC(3) = 130.812800
SNDN8C3H = 29
SNDN8C3L = 220
; fCIS(3) = 138.591600
SNDN8CIS3H = 28
SNDN8CIS3L = 46
; fD(3) = 146.832400
SNDN8D3H = 26
SNDN8D3L = 153
; fDIS(3) = 155.563600
SNDN8DIS3H = 25
SNDN8DIS3L = 27
; fE(3) = 164.814000
SNDN8E3H = 23
SNDN8E3L = 178
; fF(3) = 174.614400
SNDN8F3H = 22
SNDN8F3L = 94
; fFIS(3) = 184.997200
SNDN8FIS3H = 21
SNDN8FIS3L = 28
; fG(3) = 195.998000
SNDN8G3H = 19
SNDN8G3L = 237
; fGIS(3) = 207.652000
SNDN8GIS3H = 18
SNDN8GIS3L = 207
; fA(3) = 220.000000
SNDN8A3H = 17
SNDN8A3L = 192
; fAIS(3) = 233.082000
SNDN8AIS3H = 16
SNDN8AIS3L = 193
; fB(3) = 246.941600
SNDN8B3H = 15
SNDN8B3L = 209
; fC(4) = 261.625600
SNDN8C4H = 14
SNDN8C4L = 237
; fCIS(4) = 277.183200
SNDN8CIS4H = 14
SNDN8CIS4L = 23
; fD(4) = 293.664800
SNDN8D4H = 13
SNDN8D4L = 76
; fDIS(4) = 311.127200
SNDN8DIS4H = 12
SNDN8DIS4L = 141
; fE(4) = 329.628000
SNDN8E4H = 11
SNDN8E4L = 217
; fF(4) = 349.228800
SNDN8F4H = 11
SNDN8F4L = 46
; fFIS(4) = 369.994400
SNDN8FIS4H = 10
SNDN8FIS4L = 142
; fG(4) = 391.996000
SNDN8G4H = 9
SNDN8G4L = 246
; fGIS(4) = 415.304000
SNDN8GIS4H = 9
SNDN8GIS4L = 103
; fA(4) = 440.000000
SNDN8A4H = 8
SNDN8A4L = 224
; fAIS(4) = 466.164000
SNDN8AIS4H = 8
SNDN8AIS4L = 96
; fB(4) = 493.883200
SNDN8B4H = 7
SNDN8B4L = 232
; fC(5) = 523.251200
SNDN8C5H = 7
SNDN8C5L = 118
; fCIS(5) = 554.366400
SNDN8CIS5H = 7
SNDN8CIS5L = 11
; fD(5) = 587.329600
SNDN8D5H = 6
SNDN8D5L = 166
; fDIS(5) = 622.254400
SNDN8DIS5H = 6
SNDN8DIS5L = 70
; fE(5) = 659.256000
SNDN8E5H = 5
SNDN8E5L = 236
; fF(5) = 698.457600
SNDN8F5H = 5
SNDN8F5L = 151
; fFIS(5) = 739.988800
SNDN8FIS5H = 5
SNDN8FIS5L = 70
; fG(5) = 783.992000
SNDN8G5H = 4
SNDN8G5L = 251
; fGIS(5) = 830.608000
SNDN8GIS5H = 4
SNDN8GIS5L = 179
; fA(5) = 880.000000
SNDN8A5H = 4
SNDN8A5L = 111
; fAIS(5) = 932.328000
SNDN8AIS5H = 4
SNDN8AIS5L = 48
; fB(5) = 987.766400
SNDN8B5H = 3
SNDN8B5L = 243
; fC(6) = 1046.502400
SNDN8C6H = 3
SNDN8C6L = 187
; fCIS(6) = 1108.732800
SNDN8CIS6H = 3
SNDN8CIS6L = 133
; fD(6) = 1174.659200
SNDN8D6H = 3
SNDN8D6L = 82
; fDIS(6) = 1244.508800
SNDN8DIS6H = 3
SNDN8DIS6L = 35
; fE(6) = 1318.512000
SNDN8E6H = 2
SNDN8E6L = 245
; fF(6) = 1396.915200
SNDN8F6H = 2
SNDN8F6L = 203
; fFIS(6) = 1479.977600
SNDN8FIS6H = 2
SNDN8FIS6L = 163
; fG(6) = 1567.984000
SNDN8G6H = 2
SNDN8G6L = 125
; fGIS(6) = 1661.216000
SNDN8GIS6H = 2
SNDN8GIS6L = 89
; fA(6) = 1760.000000
SNDN8A6H = 2
SNDN8A6L = 55
; fAIS(6) = 1864.656000
SNDN8AIS6H = 2
SNDN8AIS6L = 23
; fB(6) = 1975.532800
SNDN8B6H = 1
SNDN8B6L = 249
; fC(7) = 2093.004800
SNDN8C7H = 1
SNDN8C7L = 221
; fCIS(7) = 2217.465600
SNDN8CIS7H = 1
SNDN8CIS7L = 194
; fD(7) = 2349.318400
SNDN8D7H = 1
SNDN8D7L = 169
; fDIS(7) = 2489.017600
SNDN8DIS7H = 1
SNDN8DIS7L = 145
; fE(7) = 2637.024000
SNDN8E7H = 1
SNDN8E7L = 122
; fF(7) = 2793.830400
SNDN8F7H = 1
SNDN8F7L = 101
; fFIS(7) = 2959.955200
SNDN8FIS7H = 1
SNDN8FIS7L = 81
; fG(7) = 3135.968000
SNDN8G7H = 1
SNDN8G7L = 62
; fGIS(7) = 3322.432000
SNDN8GIS7H = 1
SNDN8GIS7L = 44
; fA(7) = 3520.000000
SNDN8A7H = 1
SNDN8A7L = 27
; fAIS(7) = 3729.312000
SNDN8AIS7H = 1
SNDN8AIS7L = 11
; fB(7) = 3951.065600
SNDN8B7H = 0
SNDN8B7L = 252
; fC(8) = 4186.009600
SNDN8C8H = 0
SNDN8C8L = 238
; fCIS(8) = 4434.931200
SNDN8CIS8H = 0
SNDN8CIS8L = 224
; fD(8) = 4698.636800
SNDN8D8H = 0
SNDN8D8L = 212
; fDIS(8) = 4978.035200
SNDN8DIS8H = 0
SNDN8DIS8L = 200
; fE(8) = 5274.048000
SNDN8E8H = 0
SNDN8E8L = 189
; fF(8) = 5587.660800
SNDN8F8H = 0
SNDN8F8L = 178
; fFIS(8) = 5919.910400
SNDN8FIS8H = 0
SNDN8FIS8L = 168
; fG(8) = 6271.936000
SNDN8G8H = 0
SNDN8G8L = 158
; fGIS(8) = 6644.864000
SNDN8GIS8H = 0
SNDN8GIS8L = 149
; fA(8) = 7040.000000
SNDN8A8H = 0
SNDN8A8L = 141
; fAIS(8) = 7458.624000
SNDN8AIS8H = 0
SNDN8AIS8L = 133
; fB(8) = 7902.131200
SNDN8B8H = 0
SNDN8B8L = 126
