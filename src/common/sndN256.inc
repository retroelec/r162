; fB(2) = 123.470800
SNDN256B2 = 252
; fC(3) = 130.812800
SNDN256C3 = 238
; fCIS(3) = 138.591600
SNDN256CIS3 = 224
; fD(3) = 146.832400
SNDN256D3 = 212
; fDIS(3) = 155.563600
SNDN256DIS3 = 200
; fE(3) = 164.814000
SNDN256E3 = 189
; fF(3) = 174.614400
SNDN256F3 = 178
; fFIS(3) = 184.997200
SNDN256FIS3 = 168
; fG(3) = 195.998000
SNDN256G3 = 158
; fGIS(3) = 207.652000
SNDN256GIS3 = 149
; fA(3) = 220.000000
SNDN256A3 = 141
; fAIS(3) = 233.082000
SNDN256AIS3 = 133
; fB(3) = 246.941600
SNDN256B3 = 126
; fC(4) = 261.625600
SNDN256C4 = 118
; fCIS(4) = 277.183200
SNDN256CIS4 = 112
; fD(4) = 293.664800
SNDN256D4 = 105
; fDIS(4) = 311.127200
SNDN256DIS4 = 99
; fE(4) = 329.628000
SNDN256E4 = 94
; fF(4) = 349.228800
SNDN256F4 = 88
; fFIS(4) = 369.994400
SNDN256FIS4 = 83
; fG(4) = 391.996000
SNDN256G4 = 79
; fGIS(4) = 415.304000
SNDN256GIS4 = 74
; fA(4) = 440.000000
SNDN256A4 = 70
; fAIS(4) = 466.164000
SNDN256AIS4 = 66
; fB(4) = 493.883200
SNDN256B4 = 62
; fC(5) = 523.251200
SNDN256C5 = 59
; fCIS(5) = 554.366400
SNDN256CIS5 = 55
; fD(5) = 587.329600
SNDN256D5 = 52
; fDIS(5) = 622.254400
SNDN256DIS5 = 49
; fE(5) = 659.256000
SNDN256E5 = 46
; fF(5) = 698.457600
SNDN256F5 = 44
; fFIS(5) = 739.988800
SNDN256FIS5 = 41
; fG(5) = 783.992000
SNDN256G5 = 39
; fGIS(5) = 830.608000
SNDN256GIS5 = 37
; fA(5) = 880.000000
SNDN256A5 = 35
; fAIS(5) = 932.328000
SNDN256AIS5 = 33
; fB(5) = 987.766400
SNDN256B5 = 31
; fC(6) = 1046.502400
SNDN256C6 = 29
; fCIS(6) = 1108.732800
SNDN256CIS6 = 27
; fD(6) = 1174.659200
SNDN256D6 = 26
; fDIS(6) = 1244.508800
SNDN256DIS6 = 24
; fE(6) = 1318.512000
SNDN256E6 = 23
; fF(6) = 1396.915200
SNDN256F6 = 21
; fFIS(6) = 1479.977600
SNDN256FIS6 = 20
; fG(6) = 1567.984000
SNDN256G6 = 19
; fGIS(6) = 1661.216000
SNDN256GIS6 = 18
; fA(6) = 1760.000000
SNDN256A6 = 17
; fAIS(6) = 1864.656000
SNDN256AIS6 = 16
; fB(6) = 1975.532800
SNDN256B6 = 15
; fC(7) = 2093.004800
SNDN256C7 = 14
; fCIS(7) = 2217.465600
SNDN256CIS7 = 13
; fD(7) = 2349.318400
SNDN256D7 = 12
; fDIS(7) = 2489.017600
SNDN256DIS7 = 12
; fE(7) = 2637.024000
SNDN256E7 = 11
; fF(7) = 2793.830400
SNDN256F7 = 10
; fFIS(7) = 2959.955200
SNDN256FIS7 = 10
; fG(7) = 3135.968000
SNDN256G7 = 9
; fGIS(7) = 3322.432000
SNDN256GIS7 = 8
; fA(7) = 3520.000000
SNDN256A7 = 8
; fAIS(7) = 3729.312000
SNDN256AIS7 = 7
; fB(7) = 3951.065600
SNDN256B7 = 7
; fC(8) = 4186.009600
SNDN256C8 = 6
; fCIS(8) = 4434.931200
SNDN256CIS8 = 6
; fD(8) = 4698.636800
SNDN256D8 = 6
; fDIS(8) = 4978.035200
SNDN256DIS8 = 5
; fE(8) = 5274.048000
SNDN256E8 = 5
; fF(8) = 5587.660800
SNDN256F8 = 5
; fFIS(8) = 5919.910400
SNDN256FIS8 = 4
; fG(8) = 6271.936000
SNDN256G8 = 4
; fGIS(8) = 6644.864000
SNDN256GIS8 = 4
; fA(8) = 7040.000000
SNDN256A8 = 3
; fAIS(8) = 7458.624000
SNDN256AIS8 = 3
; fB(8) = 7902.131200
SNDN256B8 = 3
