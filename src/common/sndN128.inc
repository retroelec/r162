; fB(3) = 246.941600
SNDN128B3 = 252
; fC(4) = 261.625600
SNDN128C4 = 238
; fCIS(4) = 277.183200
SNDN128CIS4 = 224
; fD(4) = 293.664800
SNDN128D4 = 212
; fDIS(4) = 311.127200
SNDN128DIS4 = 200
; fE(4) = 329.628000
SNDN128E4 = 189
; fF(4) = 349.228800
SNDN128F4 = 178
; fFIS(4) = 369.994400
SNDN128FIS4 = 168
; fG(4) = 391.996000
SNDN128G4 = 158
; fGIS(4) = 415.304000
SNDN128GIS4 = 149
; fA(4) = 440.000000
SNDN128A4 = 141
; fAIS(4) = 466.164000
SNDN128AIS4 = 133
; fB(4) = 493.883200
SNDN128B4 = 126
; fC(5) = 523.251200
SNDN128C5 = 118
; fCIS(5) = 554.366400
SNDN128CIS5 = 112
; fD(5) = 587.329600
SNDN128D5 = 105
; fDIS(5) = 622.254400
SNDN128DIS5 = 99
; fE(5) = 659.256000
SNDN128E5 = 94
; fF(5) = 698.457600
SNDN128F5 = 88
; fFIS(5) = 739.988800
SNDN128FIS5 = 83
; fG(5) = 783.992000
SNDN128G5 = 79
; fGIS(5) = 830.608000
SNDN128GIS5 = 74
; fA(5) = 880.000000
SNDN128A5 = 70
; fAIS(5) = 932.328000
SNDN128AIS5 = 66
; fB(5) = 987.766400
SNDN128B5 = 62
; fC(6) = 1046.502400
SNDN128C6 = 59
; fCIS(6) = 1108.732800
SNDN128CIS6 = 55
; fD(6) = 1174.659200
SNDN128D6 = 52
; fDIS(6) = 1244.508800
SNDN128DIS6 = 49
; fE(6) = 1318.512000
SNDN128E6 = 46
; fF(6) = 1396.915200
SNDN128F6 = 44
; fFIS(6) = 1479.977600
SNDN128FIS6 = 41
; fG(6) = 1567.984000
SNDN128G6 = 39
; fGIS(6) = 1661.216000
SNDN128GIS6 = 37
; fA(6) = 1760.000000
SNDN128A6 = 35
; fAIS(6) = 1864.656000
SNDN128AIS6 = 33
; fB(6) = 1975.532800
SNDN128B6 = 31
; fC(7) = 2093.004800
SNDN128C7 = 29
; fCIS(7) = 2217.465600
SNDN128CIS7 = 27
; fD(7) = 2349.318400
SNDN128D7 = 26
; fDIS(7) = 2489.017600
SNDN128DIS7 = 24
; fE(7) = 2637.024000
SNDN128E7 = 23
; fF(7) = 2793.830400
SNDN128F7 = 21
; fFIS(7) = 2959.955200
SNDN128FIS7 = 20
; fG(7) = 3135.968000
SNDN128G7 = 19
; fGIS(7) = 3322.432000
SNDN128GIS7 = 18
; fA(7) = 3520.000000
SNDN128A7 = 17
; fAIS(7) = 3729.312000
SNDN128AIS7 = 16
; fB(7) = 3951.065600
SNDN128B7 = 15
; fC(8) = 4186.009600
SNDN128C8 = 14
; fCIS(8) = 4434.931200
SNDN128CIS8 = 13
; fD(8) = 4698.636800
SNDN128D8 = 12
; fDIS(8) = 4978.035200
SNDN128DIS8 = 12
; fE(8) = 5274.048000
SNDN128E8 = 11
; fF(8) = 5587.660800
SNDN128F8 = 10
; fFIS(8) = 5919.910400
SNDN128FIS8 = 10
; fG(8) = 6271.936000
SNDN128G8 = 9
; fGIS(8) = 6644.864000
SNDN128GIS8 = 8
; fA(8) = 7040.000000
SNDN128A8 = 8
; fAIS(8) = 7458.624000
SNDN128AIS8 = 7
; fB(8) = 7902.131200
SNDN128B8 = 7
